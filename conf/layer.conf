## conf/layer.conf
```bitbake
# We have a conf and classes directory, add to BBPATH
BBPATH .= ":${LAYERDIR}"

# We have recipes-* directories, add to BBFILES
BBFILES += "${LAYERDIR}/recipes-*/*/*.bb \
            ${LAYERDIR}/recipes-*/*/*.bbappend \
            ${LAYERDIR}/packagegroups/*.bb \
            ${LAYERDIR}/packagegroups/*.bbappend \
            ${LAYERDIR}/bundles/*.bb"

BBFILE_COLLECTIONS += "everest-chargebyte"
BBFILE_PATTERN_everest-chargebyte = "^${LAYERDIR}/"

LAYERDEPENDS_everest-chargebyte = "meta-everest"

LAYERSERIES_COMPAT_everest-chargebyte = "kirkstone"
```
